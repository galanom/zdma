## yocto/build/conf/bblayers.conf
```bitbake
# POKY_BBLAYERS_CONF_VERSION is increased each time build/conf/bblayers.conf
# changes incompatibly
POKY_BBLAYERS_CONF_VERSION = "2"

BBPATH = "${TOPDIR}"
BBFILES ?= ""

BBLAYERS ?= " \
  /home/igalanommatis/work/zdma/yocto/meta \
  /home/igalanommatis/work/zdma/yocto/meta-poky \
  /home/igalanommatis/work/zdma/yocto/meta-yocto-bsp \
  /home/igalanommatis/work/zdma/yocto/meta-openembedded/meta-oe \
  /home/igalanommatis/work/zdma/yocto/meta-xilinx \
  /home/igalanommatis/work/zdma/yocto/meta-local \
  "
```

## yocto/meta-user/conf/layer.conf
```bitbake
# We have a conf and classes directory, add to BBPATH
BBPATH .= ":${LAYERDIR}"

# We have recipes-* directories, add to BBFILES
BBFILES += "${LAYERDIR}/recipes-*/*/*.bb \
	${LAYERDIR}/recipes-*/*/*.bbappend"

BBFILE_COLLECTIONS += "user"
BBFILE_PATTERN_user = "^${LAYERDIR}/"
BBFILE_PRIORITY_user = "7"
```
